/**
 * These arguments were used when this file was generated. They will be automatically applied on subsequent loads
 * via the GUI or CLI. Run CLI with '--help' for additional information on how to override these arguments.
 * @cliArgs --device "F2838x" --part "F2838x_337bga" --package "337bga"
 * @v2CliArgs --device "TMS320F28388D" --package "337bga"
 * @versions {"tool":"1.26.2+4477"}
 */
scripting.excludeFromBuild("f2838x_pinmux.c");
scripting.excludeFromBuild("f2838x_pinmux.h");

/**
 * These are the peripherals and settings in this configuration
 */
const ECAT1                            = scripting.addPeripheral("ECAT");
ECAT1.$name                            = "ECAT";
ECAT1.$assign                          = "ECAT";
ECAT1.ESC_LED_LINK0_ACTIVE.$assign     = "GPIO143";
ECAT1.ESC_LED_LINK1_ACTIVE.$assign     = "GPIO144";
ECAT1.ESC_LED_RUN.$assign              = "GPIO146";
ECAT1.ESC_LED_ERR.$assign              = "GPIO145";
ECAT1.ESC_LED_STATE_RUN.$assign        = "GPIO147";
ECAT1.ESC_I2C_SDA.$assign              = "GPIO150";
ECAT1.ESC_I2C_SCL.$assign              = "GPIO151";
ECAT1.ESC_TX1_DATA3.$assign            = "GPIO135";
ECAT1.ESC_TX1_DATA2.$assign            = "GPIO134";
ECAT1.ESC_TX1_DATA1.$assign            = "GPIO132";
ECAT1.ESC_TX1_DATA0.$assign            = "GPIO131";
ECAT1.ESC_SYNC0.$assign                = "GPIO34";
ECAT1.ESC_SYNC1.$assign                = "GPIO30";
ECAT1.ESC_MDIO_CLK.$assign             = "GPIO152";
ECAT1.ESC_MDIO_DATA.$assign            = "GPIO153";
ECAT1.ESC_PHY_CLK.$used                = false;
ECAT1.ESC_TX1_ENA.$assign              = "GPIO129";
ECAT1.ESC_RX1_CLK.$assign              = "GPIO137";
ECAT1.ESC_RX1_DV.$assign               = "GPIO136";
ECAT1.ESC_RX1_ERR.$assign              = "GPIO138";
ECAT1.ESC_RX1_DATA0.$assign            = "GPIO139";
ECAT1.ESC_RX1_DATA1.$assign            = "GPIO140";
ECAT1.ESC_RX1_DATA2.$assign            = "GPIO141";
ECAT1.ESC_RX1_DATA3.$assign            = "GPIO142";
ECAT1.ESC_PHY_RESETn.$assign           = "GPIO155";
ECAT1.ESC_RX0_CLK.$assign              = "GPIO163";
ECAT1.ESC_RX0_DV.$assign               = "GPIO162";
ECAT1.ESC_RX0_ERR.$assign              = "GPIO164";
ECAT1.ESC_RX0_DATA0.$assign            = "GPIO165";
ECAT1.ESC_RX0_DATA1.$assign            = "GPIO166";
ECAT1.ESC_RX0_DATA2.$assign            = "GPIO167";
ECAT1.ESC_RX0_DATA3.$assign            = "GPIO168";
ECAT1.ESC_TX0_CLK.$assign              = "GPIO157";
ECAT1.ESC_TX0_DATA0.$assign            = "GPIO158";
ECAT1.ESC_TX0_DATA1.$assign            = "GPIO159";
ECAT1.ESC_TX0_DATA2.$assign            = "GPIO160";
ECAT1.ESC_TX0_DATA3.$assign            = "GPIO161";
ECAT1.ESC_TX0_ENA.$assign              = "GPIO156";
ECAT1.ESC_TX1_CLK.$assign              = "GPIO130";
ECAT1.ESC_LATCH0.$assign               = "GPIO125";
ECAT1.ESC_LATCH1.$assign               = "GPIO126";
ECAT1.ESC_PHY0_LINKSTATUS.$assign      = "GPIO148";
ECAT1.ESC_PHY1_LINKSTATUS.$assign      = "GPIO149";
ECAT1.ESC_GPI0.$used                   = false;
ECAT1.ESC_GPI1.$used                   = false;
ECAT1.ESC_GPI2.$used                   = false;
ECAT1.ESC_GPI3.$used                   = false;
ECAT1.ESC_GPI4.$used                   = false;
ECAT1.ESC_GPI5.$used                   = false;
ECAT1.ESC_GPI6.$used                   = false;
ECAT1.ESC_GPI7.$used                   = false;
ECAT1.ESC_GPI8.$used                   = false;
ECAT1.ESC_GPI9.$used                   = false;
ECAT1.ESC_GPI10.$used                  = false;
ECAT1.ESC_GPI11.$used                  = false;
ECAT1.ESC_GPI12.$used                  = false;
ECAT1.ESC_GPI13.$used                  = false;
ECAT1.ESC_GPI14.$used                  = false;
ECAT1.ESC_GPI15.$used                  = false;
ECAT1.ESC_GPI16.$used                  = false;
ECAT1.ESC_GPI17.$used                  = false;
ECAT1.ESC_GPI18.$used                  = false;
ECAT1.ESC_GPI19.$used                  = false;
ECAT1.ESC_GPI20.$used                  = false;
ECAT1.ESC_GPI21.$used                  = false;
ECAT1.ESC_GPI22.$used                  = false;
ECAT1.ESC_GPI23.$used                  = false;
ECAT1.ESC_GPI24.$used                  = false;
ECAT1.ESC_GPI25.$used                  = false;
ECAT1.ESC_GPI26.$used                  = false;
ECAT1.ESC_GPI27.$used                  = false;
ECAT1.ESC_GPI28.$used                  = false;
ECAT1.ESC_GPI29.$used                  = false;
ECAT1.ESC_GPI30.$used                  = false;
ECAT1.ESC_GPI31.$used                  = false;
ECAT1.ESC_GPO0.$used                   = false;
ECAT1.ESC_GPO1.$used                   = false;
ECAT1.ESC_GPO2.$used                   = false;
ECAT1.ESC_GPO3.$used                   = false;
ECAT1.ESC_GPO4.$used                   = false;
ECAT1.ESC_GPO5.$used                   = false;
ECAT1.ESC_GPO6.$used                   = false;
ECAT1.ESC_GPO7.$used                   = false;
ECAT1.ESC_GPO8.$used                   = false;
ECAT1.ESC_GPO9.$used                   = false;
ECAT1.ESC_GPO10.$used                  = false;
ECAT1.ESC_GPO11.$used                  = false;
ECAT1.ESC_GPO12.$used                  = false;
ECAT1.ESC_GPO13.$used                  = false;
ECAT1.ESC_GPO14.$used                  = false;
ECAT1.ESC_GPO15.$used                  = false;
ECAT1.ESC_GPO16.$used                  = false;
ECAT1.ESC_GPO17.$used                  = false;
ECAT1.ESC_GPO18.$used                  = false;
ECAT1.ESC_GPO19.$used                  = false;
ECAT1.ESC_GPO20.$used                  = false;
ECAT1.ESC_GPO21.$used                  = false;
ECAT1.ESC_GPO22.$used                  = false;
ECAT1.ESC_GPO23.$used                  = false;
ECAT1.ESC_GPO24.$used                  = false;
ECAT1.ESC_GPO25.$used                  = false;
ECAT1.ESC_GPO26.$used                  = false;
ECAT1.ESC_GPO27.$used                  = false;
ECAT1.ESC_GPO28.$used                  = false;
ECAT1.ESC_GPO29.$used                  = false;
ECAT1.ESC_GPO30.$used                  = false;
ECAT1.ESC_GPO31.$used                  = false;
const EPWM1                            = scripting.addPeripheral("EPWM");
EPWM1.$name                            = "HRPWM1";
EPWM1.$assign                          = "EPWM1";
EPWM1["EPWM#A"].$assign                = "GPIO0";
EPWM1["EPWM#B"].$assign                = "GPIO1";
const EPWM2                            = scripting.addPeripheral("EPWM");
EPWM2.$name                            = "HRPWM2";
EPWM2.$assign                          = "EPWM2";
EPWM2["EPWM#A"].$assign                = "GPIO2";
EPWM2["EPWM#B"].$assign                = "GPIO3";
const EPWM3                            = scripting.addPeripheral("EPWM");
EPWM3.$name                            = "HRPWM3";
EPWM3.$assign                          = "EPWM3";
EPWM3["EPWM#A"].$assign                = "GPIO4";
EPWM3["EPWM#B"].$assign                = "GPIO5";
const EPWM4                            = scripting.addPeripheral("EPWM");
EPWM4.$name                            = "HRPWM4";
EPWM4.$assign                          = "EPWM4";
EPWM4["EPWM#A"].$assign                = "GPIO6";
EPWM4["EPWM#B"].$assign                = "GPIO7";
const EPWM5                            = scripting.addPeripheral("EPWM");
EPWM5.$name                            = "HRPWM5";
EPWM5.$assign                          = "EPWM5";
EPWM5["EPWM#A"].$assign                = "GPIO8";
EPWM5["EPWM#B"].$assign                = "GPIO9";
const EPWM6                            = scripting.addPeripheral("EPWM");
EPWM6.$name                            = "HRPWM6";
EPWM6.$assign                          = "EPWM6";
EPWM6["EPWM#A"].$assign                = "GPIO10";
EPWM6["EPWM#B"].$assign                = "GPIO11";
const EPWM7                            = scripting.addPeripheral("EPWM");
EPWM7.$name                            = "HRPWM7";
EPWM7.$assign                          = "EPWM7";
EPWM7["EPWM#A"].$assign                = "GPIO12";
EPWM7["EPWM#B"].$assign                = "GPIO13";
const EPWM8                            = scripting.addPeripheral("EPWM");
EPWM8.$name                            = "HRPWM8";
EPWM8.$assign                          = "EPWM8";
EPWM8["EPWM#A"].$assign                = "GPIO14";
EPWM8["EPWM#B"].$assign                = "GPIO15";
const EPWM9                            = scripting.addPeripheral("EPWM");
EPWM9.$name                            = "EPWM9";
EPWM9.$assign                          = "EPWM9";
EPWM9["EPWM#A"].$assign                = "GPIO16";
EPWM9["EPWM#B"].$assign                = "GPIO17";
const EPWM10                           = scripting.addPeripheral("EPWM");
EPWM10.$name                           = "EPWM10";
EPWM10.$assign                         = "EPWM10";
EPWM10["EPWM#A"].$assign               = "GPIO18";
EPWM10["EPWM#B"].$assign               = "GPIO19";
const EPWM11                           = scripting.addPeripheral("EPWM");
EPWM11.$name                           = "EPWM11";
EPWM11.$assign                         = "EPWM11";
EPWM11["EPWM#A"].$assign               = "GPIO20";
EPWM11["EPWM#B"].$assign               = "GPIO21";
const EPWM12                           = scripting.addPeripheral("EPWM");
EPWM12.$name                           = "EPWM12";
EPWM12.$assign                         = "EPWM12";
EPWM12["EPWM#A"].$assign               = "GPIO22";
EPWM12["EPWM#B"].$assign               = "GPIO23";
const ETHERNET1                        = scripting.addPeripheral("ETHERNET");
ETHERNET1.$name                        = "MyETHERNET1";
ETHERNET1.ENET_MII_CRS.$assign         = "GPIO109";
ETHERNET1.ENET_MII_COL.$assign         = "GPIO110";
ETHERNET1.ENET_MII_RX_CLK.$assign      = "GPIO111";
ETHERNET1.ENET_MII_RX_DV.$assign       = "GPIO112";
ETHERNET1.ENET_MII_RX_ERR.$assign      = "GPIO113";
ETHERNET1.ENET_MII_RX_DATA0.$assign    = "GPIO114";
ETHERNET1.ENET_MII_RX_DATA1.$assign    = "GPIO115";
ETHERNET1.ENET_MII_RX_DATA2.$assign    = "GPIO116";
ETHERNET1.ENET_MII_RX_DATA3.$assign    = "GPIO117";
ETHERNET1.ENET_MII_TX_EN.$assign       = "GPIO118";
ETHERNET1.ENET_MII_TX_ERR.$assign      = "GPIO119";
ETHERNET1.ENET_MII_TX_CLK.$assign      = "GPIO44";
ETHERNET1.ENET_MII_TX_DATA0.$assign    = "GPIO59";
ETHERNET1.ENET_MII_TX_DATA1.$assign    = "GPIO122";
ETHERNET1.ENET_MII_TX_DATA2.$assign    = "GPIO123";
ETHERNET1.ENET_MII_TX_DATA3.$assign    = "GPIO124";
ETHERNET1.ENET_MII_INTR.$assign        = "GPIO108";
ETHERNET1.ENET_MDIO_CLK.$assign        = "GPIO105";
ETHERNET1.ENET_MDIO_DATA.$assign       = "GPIO106";
ETHERNET1.ENET_RMII_CLK.$assign        = "GPIO73";
ETHERNET1.ENET_RMII_CLK.$used          = false;
ETHERNET1.ENET_REVMII_MDIO_RST.$assign = "GPIO41";
ETHERNET1.ENET_PPS0.$assign            = "GPIO47";
ETHERNET1.ENET_PPS1.$assign            = "GPIO48";
const GPIO1                            = scripting.addPeripheral("GPIO");
GPIO1.$numPins                         = 4;
GPIO1["0"].$assign                     = "GPIO154";
GPIO1["1"].$assign                     = "GPIO107";
GPIO1["2"].$assign                     = "GPIO120";
GPIO1["3"].$assign                     = "GPIO121";
GPIO1.$name                            = "Buffer_Out_In";
const SCI1                             = scripting.addPeripheral("SCI");
SCI1.$name                             = "SCIA";
SCI1.$assign                           = "SCIA";
SCI1["SCI@_RX"].$assign                = "GPIO28";
SCI1["SCI@_TX"].$assign                = "GPIO29";
const SCI2                             = scripting.addPeripheral("SCI");
SCI2.$name                             = "SCIC";
SCI2.$assign                           = "SCIC";
SCI2["SCI@_RX"].$assign                = "GPIO39";
SCI2["SCI@_TX"].$assign                = "GPIO38";
const SPI1                             = scripting.addPeripheral("SPI");
SPI1.$useCase                          = "ALL";
SPI1.$name                             = "SPIB_SLAVE";
SPI1.$assign                           = "SPIB";
SPI1["SPI@_SIMO"].$assign              = "GPIO24";
SPI1["SPI@_SOMI"].$assign              = "GPIO61";
SPI1["SPI@_CLK"].$assign               = "GPIO26";
SPI1["SPI@_STEn"].$assign              = "GPIO27";
const UART1                            = scripting.addPeripheral("UART");
UART1.$name                            = "UART";
UART1.$assign                          = "UARTA";
UART1["UART@_TX"].$assign              = "GPIO42";
UART1["UART@_RX"].$assign              = "GPIO43";

/**
 * Pinmux solution for unlocked pins/peripherals. This ensures that minor changes to the automatic solver in a future
 * version of the tool will not impact the pinmux you originally saw.  These lines can be completely deleted in order to
 * re-solve from scratch.
 */
ETHERNET1.$suggestSolution = "ETHERNET";
