/**
 * These arguments were used when this file was generated. They will be automatically applied on subsequent loads
 * via the GUI or CLI. Run CLI with '--help' for additional information on how to override these arguments.
 * @cliArgs --device "F2838x" --part "F2838x_337bga" --package "337bga"
 * @v2CliArgs --device "TMS320F28388D" --package "337bga"
 * @versions {"tool":"1.26.2+4477"}
 */
scripting.excludeFromBuild("f2838x_pinmux.c");
scripting.excludeFromBuild("f2838x_pinmux.h");

/**
 * These are the peripherals and settings in this configuration
 */
const UART1               = scripting.addPeripheral("UART");
UART1.$name               = "UART";
UART1.$assign             = "UARTA";
UART1["UART@_TX"].$assign = "GPIO42";
UART1["UART@_RX"].$assign = "GPIO43";
