/**
 * These arguments were used when this file was generated. They will be automatically applied on subsequent loads
 * via the GUI or CLI. Run CLI with '--help' for additional information on how to override these arguments.
 * @cliArgs --device "F2838x" --part "F2838x_337bga" --package "337bga"
 * @v2CliArgs --device "TMS320F28388D" --package "337bga"
 * @versions {"tool":"1.26.2+4477"}
 */
scripting.excludeFromBuild("f2838x_pinmux.c");
scripting.excludeFromBuild("f2838x_pinmux.h");

/**
 * These are the peripherals and settings in this configuration
 */
const EPWM1               = scripting.addPeripheral("EPWM");
EPWM1.$name               = "HRPWM1";
EPWM1.$assign             = "EPWM1";
EPWM1["EPWM#A"].$assign   = "GPIO0";
EPWM1["EPWM#B"].$assign   = "GPIO1";
const EPWM2               = scripting.addPeripheral("EPWM");
EPWM2.$name               = "HRPWM2";
EPWM2.$assign             = "EPWM2";
EPWM2["EPWM#A"].$assign   = "GPIO2";
EPWM2["EPWM#B"].$assign   = "GPIO3";
const EPWM3               = scripting.addPeripheral("EPWM");
EPWM3.$name               = "HRPWM3";
EPWM3.$assign             = "EPWM3";
EPWM3["EPWM#A"].$assign   = "GPIO4";
EPWM3["EPWM#B"].$assign   = "GPIO5";
const EPWM4               = scripting.addPeripheral("EPWM");
EPWM4.$name               = "HRPWM4";
EPWM4.$assign             = "EPWM4";
EPWM4["EPWM#A"].$assign   = "GPIO6";
EPWM4["EPWM#B"].$assign   = "GPIO7";
const EPWM5               = scripting.addPeripheral("EPWM");
EPWM5.$name               = "HRPWM5";
EPWM5.$assign             = "EPWM5";
EPWM5["EPWM#A"].$assign   = "GPIO8";
EPWM5["EPWM#B"].$assign   = "GPIO9";
const EPWM6               = scripting.addPeripheral("EPWM");
EPWM6.$name               = "HRPWM6";
EPWM6.$assign             = "EPWM6";
EPWM6["EPWM#A"].$assign   = "GPIO10";
EPWM6["EPWM#B"].$assign   = "GPIO11";
const EPWM7               = scripting.addPeripheral("EPWM");
EPWM7.$name               = "HRPWM7";
EPWM7.$assign             = "EPWM7";
EPWM7["EPWM#A"].$assign   = "GPIO12";
EPWM7["EPWM#B"].$assign   = "GPIO13";
const EPWM8               = scripting.addPeripheral("EPWM");
EPWM8.$name               = "HRPWM8";
EPWM8.$assign             = "EPWM8";
EPWM8["EPWM#A"].$assign   = "GPIO14";
EPWM8["EPWM#B"].$assign   = "GPIO15";
const EPWM9               = scripting.addPeripheral("EPWM");
EPWM9.$name               = "EPWM9";
EPWM9.$assign             = "EPWM9";
EPWM9["EPWM#A"].$assign   = "GPIO16";
EPWM9["EPWM#B"].$assign   = "GPIO17";
const EPWM10              = scripting.addPeripheral("EPWM");
EPWM10.$name              = "EPWM10";
EPWM10.$assign            = "EPWM10";
EPWM10["EPWM#A"].$assign  = "GPIO18";
EPWM10["EPWM#B"].$assign  = "GPIO19";
const EPWM11              = scripting.addPeripheral("EPWM");
EPWM11.$name              = "EPWM11";
EPWM11.$assign            = "EPWM11";
EPWM11["EPWM#A"].$assign  = "GPIO20";
EPWM11["EPWM#B"].$assign  = "GPIO21";
const EPWM12              = scripting.addPeripheral("EPWM");
EPWM12.$name              = "EPWM12";
EPWM12.$assign            = "EPWM12";
EPWM12["EPWM#A"].$assign  = "GPIO22";
EPWM12["EPWM#B"].$assign  = "GPIO23";
const UART1               = scripting.addPeripheral("UART");
UART1.$name               = "UART";
UART1.$assign             = "UARTA";
UART1["UART@_TX"].$assign = "GPIO42";
UART1["UART@_RX"].$assign = "GPIO43";
