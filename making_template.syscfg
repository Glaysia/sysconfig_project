/**
 * @cliArgs --device "F2838x" --part "F2838x_337bga" --package "337bga"
 * @versions {"tool":"1.26.2+4477"}
 */
scripting.excludeFromBuild("f2838x_pinmux.c");
scripting.excludeFromBuild("f2838x_pinmux.h");

/**
 * These are the peripherals and settings in this configuration
 */
const ECAT1                            = scripting.addPeripheral("ECAT");
ECAT1.$name                            = "MyECAT1";
ECAT1.ESC_LED_LINK0_ACTIVE.$assign     = "GPIO143";
ECAT1.ESC_LED_LINK1_ACTIVE.$assign     = "GPIO144";
ECAT1.ESC_LED_RUN.$assign              = "GPIO146";
ECAT1.ESC_LED_ERR.$assign              = "GPIO145";
ECAT1.ESC_LED_STATE_RUN.$assign        = "GPIO147";
ECAT1.ESC_I2C_SDA.$assign              = "GPIO150";
ECAT1.ESC_I2C_SCL.$assign              = "GPIO151";
ECAT1.ESC_TX1_DATA3.$assign            = "GPIO135";
ECAT1.ESC_TX1_DATA2.$assign            = "GPIO134";
ECAT1.ESC_TX1_DATA1.$assign            = "GPIO132";
ECAT1.ESC_TX1_DATA0.$assign            = "GPIO131";
ECAT1.ESC_SYNC0.$assign                = "GPIO127";
ECAT1.ESC_SYNC1.$assign                = "GPIO128";
ECAT1.ESC_MDIO_CLK.$assign             = "GPIO152";
ECAT1.ESC_MDIO_DATA.$assign            = "GPIO153";
ECAT1.ESC_PHY_CLK.$assign              = "GPIO154";
ECAT1.ESC_TX1_ENA.$assign              = "GPIO129";
ECAT1.ESC_RX1_CLK.$assign              = "GPIO137";
ECAT1.ESC_RX1_DV.$assign               = "GPIO136";
ECAT1.ESC_RX1_ERR.$assign              = "GPIO138";
ECAT1.ESC_RX1_DATA0.$assign            = "GPIO139";
ECAT1.ESC_RX1_DATA1.$assign            = "GPIO140";
ECAT1.ESC_RX1_DATA2.$assign            = "GPIO141";
ECAT1.ESC_RX1_DATA3.$assign            = "GPIO142";
ECAT1.ESC_PHY_RESETn.$assign           = "GPIO155";
ECAT1.ESC_RX0_CLK.$assign              = "GPIO163";
ECAT1.ESC_RX0_DV.$assign               = "GPIO162";
ECAT1.ESC_RX0_ERR.$assign              = "GPIO164";
ECAT1.ESC_RX0_DATA0.$assign            = "GPIO165";
ECAT1.ESC_RX0_DATA1.$assign            = "GPIO166";
ECAT1.ESC_RX0_DATA2.$assign            = "GPIO167";
ECAT1.ESC_RX0_DATA3.$assign            = "GPIO168";
ECAT1.ESC_TX0_CLK.$assign              = "GPIO157";
ECAT1.ESC_TX0_DATA0.$assign            = "GPIO158";
ECAT1.ESC_TX0_DATA1.$assign            = "GPIO159";
ECAT1.ESC_TX0_DATA2.$assign            = "GPIO160";
ECAT1.ESC_TX0_DATA3.$assign            = "GPIO161";
ECAT1.ESC_TX0_ENA.$assign              = "GPIO156";
ECAT1.ESC_TX1_CLK.$assign              = "GPIO130";
ECAT1.ESC_LATCH0.$assign               = "GPIO125";
ECAT1.ESC_LATCH1.$assign               = "GPIO126";
ECAT1.ESC_PHY0_LINKSTATUS.$assign      = "GPIO148";
ECAT1.ESC_PHY1_LINKSTATUS.$assign      = "GPIO149";
ECAT1.ESC_GPI0.$used                   = false;
ECAT1.ESC_GPI1.$used                   = false;
ECAT1.ESC_GPI2.$used                   = false;
ECAT1.ESC_GPI3.$used                   = false;
ECAT1.ESC_GPI4.$used                   = false;
ECAT1.ESC_GPI5.$used                   = false;
ECAT1.ESC_GPI6.$used                   = false;
ECAT1.ESC_GPI7.$used                   = false;
ECAT1.ESC_GPI8.$used                   = false;
ECAT1.ESC_GPI9.$used                   = false;
ECAT1.ESC_GPI10.$used                  = false;
ECAT1.ESC_GPI11.$used                  = false;
ECAT1.ESC_GPI12.$used                  = false;
ECAT1.ESC_GPI13.$used                  = false;
ECAT1.ESC_GPI14.$used                  = false;
ECAT1.ESC_GPI15.$used                  = false;
ECAT1.ESC_GPI16.$used                  = false;
ECAT1.ESC_GPI17.$used                  = false;
ECAT1.ESC_GPI18.$used                  = false;
ECAT1.ESC_GPI19.$used                  = false;
ECAT1.ESC_GPI20.$used                  = false;
ECAT1.ESC_GPI21.$used                  = false;
ECAT1.ESC_GPI22.$used                  = false;
ECAT1.ESC_GPI23.$used                  = false;
ECAT1.ESC_GPI24.$used                  = false;
ECAT1.ESC_GPI25.$used                  = false;
ECAT1.ESC_GPI26.$used                  = false;
ECAT1.ESC_GPI27.$used                  = false;
ECAT1.ESC_GPI28.$used                  = false;
ECAT1.ESC_GPI29.$used                  = false;
ECAT1.ESC_GPI30.$used                  = false;
ECAT1.ESC_GPI31.$used                  = false;
ECAT1.ESC_GPO0.$used                   = false;
ECAT1.ESC_GPO1.$used                   = false;
ECAT1.ESC_GPO2.$used                   = false;
ECAT1.ESC_GPO3.$used                   = false;
ECAT1.ESC_GPO4.$used                   = false;
ECAT1.ESC_GPO5.$used                   = false;
ECAT1.ESC_GPO6.$used                   = false;
ECAT1.ESC_GPO7.$used                   = false;
ECAT1.ESC_GPO8.$used                   = false;
ECAT1.ESC_GPO9.$used                   = false;
ECAT1.ESC_GPO10.$used                  = false;
ECAT1.ESC_GPO11.$used                  = false;
ECAT1.ESC_GPO12.$used                  = false;
ECAT1.ESC_GPO13.$used                  = false;
ECAT1.ESC_GPO14.$used                  = false;
ECAT1.ESC_GPO15.$used                  = false;
ECAT1.ESC_GPO16.$used                  = false;
ECAT1.ESC_GPO17.$used                  = false;
ECAT1.ESC_GPO18.$used                  = false;
ECAT1.ESC_GPO19.$used                  = false;
ECAT1.ESC_GPO20.$used                  = false;
ECAT1.ESC_GPO21.$used                  = false;
ECAT1.ESC_GPO22.$used                  = false;
ECAT1.ESC_GPO23.$used                  = false;
ECAT1.ESC_GPO24.$used                  = false;
ECAT1.ESC_GPO25.$used                  = false;
ECAT1.ESC_GPO26.$used                  = false;
ECAT1.ESC_GPO27.$used                  = false;
ECAT1.ESC_GPO28.$used                  = false;
ECAT1.ESC_GPO29.$used                  = false;
ECAT1.ESC_GPO30.$used                  = false;
ECAT1.ESC_GPO31.$used                  = false;
const EPWM1                            = scripting.addPeripheral("EPWM");
EPWM1.$name                            = "MyEPWM1";
EPWM1.$assign                          = "EPWM1";
EPWM1["EPWM#A"].$assign                = "GPIO0";
EPWM1["EPWM#B"].$assign                = "GPIO1";
const EPWM2                            = scripting.addPeripheral("EPWM");
EPWM2.$name                            = "MyEPWM2";
EPWM2.$assign                          = "EPWM2";
EPWM2["EPWM#A"].$assign                = "GPIO2";
EPWM2["EPWM#B"].$assign                = "GPIO3";
const EPWM3                            = scripting.addPeripheral("EPWM");
EPWM3.$name                            = "MyEPWM3";
EPWM3.$assign                          = "EPWM3";
EPWM3["EPWM#A"].$assign                = "GPIO4";
EPWM3["EPWM#B"].$assign                = "GPIO5";
const EPWM4                            = scripting.addPeripheral("EPWM");
EPWM4.$name                            = "MyEPWM4";
EPWM4.$assign                          = "EPWM4";
EPWM4["EPWM#A"].$assign                = "GPIO6";
EPWM4["EPWM#B"].$assign                = "GPIO7";
const EPWM5                            = scripting.addPeripheral("EPWM");
EPWM5.$name                            = "MyEPWM5";
EPWM5.$assign                          = "EPWM5";
EPWM5["EPWM#A"].$assign                = "GPIO8";
EPWM5["EPWM#B"].$assign                = "GPIO9";
const EPWM6                            = scripting.addPeripheral("EPWM");
EPWM6.$name                            = "MyEPWM6";
EPWM6.$assign                          = "EPWM6";
EPWM6["EPWM#A"].$assign                = "GPIO10";
EPWM6["EPWM#B"].$assign                = "GPIO11";
const EPWM7                            = scripting.addPeripheral("EPWM");
EPWM7.$name                            = "MyEPWM7";
EPWM7.$assign                          = "EPWM7";
EPWM7["EPWM#A"].$assign                = "GPIO12";
EPWM7["EPWM#B"].$assign                = "GPIO13";
const EPWM8                            = scripting.addPeripheral("EPWM");
EPWM8.$name                            = "MyEPWM8";
EPWM8.$assign                          = "EPWM8";
EPWM8["EPWM#A"].$assign                = "GPIO14";
EPWM8["EPWM#B"].$assign                = "GPIO15";
const EPWM9                            = scripting.addPeripheral("EPWM");
EPWM9.$name                            = "MyEPWM9";
EPWM9.$assign                          = "EPWM9";
EPWM9["EPWM#A"].$assign                = "GPIO16";
EPWM9["EPWM#B"].$assign                = "GPIO17";
const EPWM10                           = scripting.addPeripheral("EPWM");
EPWM10.$name                           = "MyEPWM10";
EPWM10.$assign                         = "EPWM10";
EPWM10["EPWM#A"].$assign               = "GPIO18";
EPWM10["EPWM#B"].$assign               = "GPIO19";
const EPWM11                           = scripting.addPeripheral("EPWM");
EPWM11.$name                           = "MyEPWM11";
EPWM11.$assign                         = "EPWM11";
EPWM11["EPWM#A"].$assign               = "GPIO20";
EPWM11["EPWM#B"].$assign               = "GPIO21";
const EPWM12                           = scripting.addPeripheral("EPWM");
EPWM12.$name                           = "MyEPWM12";
EPWM12.$assign                         = "EPWM12";
EPWM12["EPWM#A"].$assign               = "GPIO22";
EPWM12["EPWM#B"].$assign               = "GPIO23";
const ETHERNET1                        = scripting.addPeripheral("ETHERNET");
ETHERNET1.$name                        = "MyETHERNET1";
ETHERNET1.ENET_MII_CRS.$assign         = "GPIO109";
ETHERNET1.ENET_MII_COL.$assign         = "GPIO110";
ETHERNET1.ENET_MII_RX_CLK.$assign      = "GPIO111";
ETHERNET1.ENET_MII_RX_DV.$assign       = "GPIO112";
ETHERNET1.ENET_MII_RX_ERR.$assign      = "GPIO113";
ETHERNET1.ENET_MII_RX_DATA0.$assign    = "GPIO114";
ETHERNET1.ENET_MII_RX_DATA1.$assign    = "GPIO115";
ETHERNET1.ENET_MII_RX_DATA2.$assign    = "GPIO116";
ETHERNET1.ENET_MII_RX_DATA3.$assign    = "GPIO117";
ETHERNET1.ENET_MII_TX_EN.$assign       = "GPIO118";
ETHERNET1.ENET_MII_TX_ERR.$assign      = "GPIO119";
ETHERNET1.ENET_MII_TX_CLK.$assign      = "GPIO44";
ETHERNET1.ENET_MII_TX_DATA0.$assign    = "GPIO75";
ETHERNET1.ENET_MII_TX_DATA1.$assign    = "GPIO122";
ETHERNET1.ENET_MII_TX_DATA2.$assign    = "GPIO123";
ETHERNET1.ENET_MII_TX_DATA3.$assign    = "GPIO124";
ETHERNET1.ENET_MII_INTR.$assign        = "GPIO108";
ETHERNET1.ENET_MDIO_CLK.$assign        = "GPIO105";
ETHERNET1.ENET_MDIO_DATA.$assign       = "GPIO106";
ETHERNET1.ENET_RMII_CLK.$assign        = "GPIO73";
ETHERNET1.ENET_REVMII_MDIO_RST.$assign = "GPIO41";
ETHERNET1.ENET_PPS0.$assign            = "GPIO47";
ETHERNET1.ENET_PPS1.$assign            = "GPIO48";
const GPIO1                            = scripting.addPeripheral("GPIO");
GPIO1.$numPins                         = 5;
GPIO1["0"].$assign                     = "GPIO42";
GPIO1["1"].$assign                     = "GPIO43";
GPIO1["2"].$assign                     = "GPIO46";
GPIO1["3"].$assign                     = "GPIO50";
GPIO1["4"].$assign                     = "GPIO100";
GPIO1.$name                            = "buffer OE";
const GPIO2                            = scripting.addPeripheral("GPIO");
GPIO2.$numPins                         = 4;
GPIO2["0"].$assign                     = "GPIO58";
GPIO2["1"].$assign                     = "GPIO59";
GPIO2["2"].$assign                     = "GPIO107";
GPIO2["3"].$assign                     = "GPIO120";
GPIO2.$name                            = "buffer DIR";
const GPIO3                            = scripting.addPeripheral("GPIO");
GPIO3.$numPins                         = 6;
GPIO3["0"].$assign                     = "GPIO24";
GPIO3["1"].$assign                     = "GPIO25";
GPIO3["2"].$assign                     = "GPIO26";
GPIO3["3"].$assign                     = "GPIO27";
GPIO3["4"].$assign                     = "GPIO28";
GPIO3["5"].$assign                     = "GPIO30";
GPIO3.$name                            = "U27";
const GPIO4                            = scripting.addPeripheral("GPIO");
GPIO4.$numPins                         = 14;
GPIO4["0"].$assign                     = "GPIO35";
GPIO4["1"].$assign                     = "GPIO37";
GPIO4["2"].$assign                     = "GPIO38";
GPIO4["3"].$assign                     = "GPIO60";
GPIO4["3"].$used                       = false;
GPIO4["4"].$assign                     = "GPIO61";
GPIO4["4"].$used                       = false;
GPIO4["5"].$assign                     = "GPIO62";
GPIO4["5"].$used                       = false;
GPIO4["6"].$assign                     = "GPIO63";
GPIO4["6"].$used                       = false;
GPIO4["7"].$assign                     = "GPIO64";
GPIO4["7"].$used                       = false;
GPIO4["8"].$assign                     = "GPIO65";
GPIO4["8"].$used                       = false;
GPIO4["9"].$assign                     = "GPIO66";
GPIO4["9"].$used                       = false;
GPIO4["10"].$assign                    = "GPIO67";
GPIO4["10"].$used                      = false;
GPIO4["11"].$assign                    = "GPIO68";
GPIO4["12"].$assign                    = "GPIO69";
GPIO4["13"].$assign                    = "GPIO70";
GPIO4.$name                            = "U25";
const GPIO5                            = scripting.addPeripheral("GPIO");
GPIO5.$numPins                         = 16;
GPIO5["0"].$assign                     = "GPIO72";
GPIO5["1"].$assign                     = "GPIO121";
GPIO5["2"].$assign                     = "GPIO74";
GPIO5["3"].$assign                     = "GPIO56";
GPIO5["4"].$assign                     = "GPIO76";
GPIO5["5"].$assign                     = "GPIO77";
GPIO5["6"].$assign                     = "GPIO78";
GPIO5["7"].$assign                     = "GPIO79";
GPIO5["8"].$assign                     = "GPIO80";
GPIO5["9"].$assign                     = "GPIO81";
GPIO5["10"].$assign                    = "GPIO82";
GPIO5["11"].$assign                    = "GPIO83";
GPIO5["12"].$assign                    = "GPIO29";
GPIO5["13"].$assign                    = "GPIO57";
GPIO5["14"].$assign                    = "GPIO51";
GPIO5["15"].$assign                    = "GPIO87";
GPIO5.$name                            = "U28";
const GPIO6                            = scripting.addPeripheral("GPIO");
GPIO6.$numPins                         = 16;
GPIO6["0"].$assign                     = "GPIO88";
GPIO6["1"].$assign                     = "GPIO89";
GPIO6["2"].$assign                     = "GPIO90";
GPIO6["3"].$assign                     = "GPIO91";
GPIO6["4"].$assign                     = "GPIO92";
GPIO6["5"].$assign                     = "GPIO93";
GPIO6["6"].$assign                     = "GPIO94";
GPIO6["7"].$assign                     = "GPIO133";
GPIO6["8"].$assign                     = "GPIO54";
GPIO6["9"].$assign                     = "GPIO95";
GPIO6["10"].$assign                    = "GPIO101";
GPIO6["11"].$assign                    = "GPIO102";
GPIO6["12"].$assign                    = "GPIO103";
GPIO6["13"].$assign                    = "GPIO104";
GPIO6["14"].$assign                    = "GPIO52";
GPIO6["15"].$assign                    = "GPIO53";
GPIO6.$name                            = "U26";
const GPIO7                            = scripting.addPeripheral("GPIO");
GPIO7.$numPins                         = 10;
GPIO7["0"].$assign                     = "GPIO45";
GPIO7["1"].$assign                     = "GPIO96";
GPIO7["2"].$assign                     = "GPIO97";
GPIO7["3"].$assign                     = "GPIO98";
GPIO7["4"].$assign                     = "GPIO99";
GPIO7["5"].$assignAllowConflicts       = "GPIO32";
GPIO7["5"].$used                       = false;
GPIO7["6"].$assign                     = "GPIO33";
GPIO7["6"].$used                       = false;
GPIO7["7"].$assign                     = "GPIO39";
GPIO7["8"].$assign                     = "GPIO40";
GPIO7["9"].$assign                     = "GPIO55";
GPIO7.$name                            = "conector";
const I2C1                             = scripting.addPeripheral("I2C");
I2C1.$name                             = "MyI2C1";
I2C1["I2C@_SDA"].$assign               = "GPIO32";
I2C1["I2C@_SCL"].$assign               = "GPIO33";
const INPUTXBAR1                       = scripting.addPeripheral("INPUTXBAR");
INPUTXBAR1.$name                       = "MyINPUTXBAR1";
INPUTXBAR1.INPUTXBAR1.$assign          = "GPIO60";
INPUTXBAR1.INPUTXBAR1.$used            = true;
INPUTXBAR1.INPUTXBAR2.$assign          = "GPIO61";
INPUTXBAR1.INPUTXBAR2.$used            = true;
INPUTXBAR1.INPUTXBAR3.$assign          = "GPIO62";
INPUTXBAR1.INPUTXBAR3.$used            = true;
INPUTXBAR1.INPUTXBAR4.$assign          = "GPIO63";
INPUTXBAR1.INPUTXBAR4.$used            = true;
INPUTXBAR1.INPUTXBAR5.$assign          = "GPIO64";
INPUTXBAR1.INPUTXBAR5.$used            = true;
INPUTXBAR1.INPUTXBAR6.$assign          = "GPIO65";
INPUTXBAR1.INPUTXBAR6.$used            = true;
INPUTXBAR1.INPUTXBAR7.$assign          = "GPIO66";
INPUTXBAR1.INPUTXBAR7.$used            = true;
INPUTXBAR1.INPUTXBAR8.$assign          = "GPIO67";
INPUTXBAR1.INPUTXBAR8.$used            = true;
INPUTXBAR1.INPUTXBAR9.$used            = false;
INPUTXBAR1.INPUTXBAR10.$used           = false;
INPUTXBAR1.INPUTXBAR11.$used           = false;
INPUTXBAR1.INPUTXBAR12.$used           = false;
INPUTXBAR1.INPUTXBAR13.$used           = false;
INPUTXBAR1.INPUTXBAR14.$used           = false;
INPUTXBAR1.INPUTXBAR15.$used           = false;
INPUTXBAR1.INPUTXBAR16.$used           = false;
const MCAN1                            = scripting.addPeripheral("MCAN");
MCAN1.$name                            = "MyMCAN1";
MCAN1.MCAN_RX.$assign                  = "GPIO36";
MCAN1.MCAN_TX.$assign                  = "GPIO31";
const SCI1                             = scripting.addPeripheral("SCI");
SCI1.$name                             = "CPU1";
SCI1["SCI@_RX"].$assign                = "GPIO49";
SCI1["SCI@_TX"].$assign                = "GPIO34";
const SCI2                             = scripting.addPeripheral("SCI");
SCI2.$name                             = "CPU2";
SCI2["SCI@_RX"].$assign                = "GPIO71";
SCI2["SCI@_TX"].$assign                = "GPIO86";
const UART1                            = scripting.addPeripheral("UART");
UART1.$name                            = "MyUART1";
UART1["UART@_TX"].$assign              = "GPIO84";
UART1["UART@_RX"].$assign              = "GPIO85";

/**
 * Pinmux solution for unlocked pins/peripherals. This ensures that minor changes to the automatic solver in a future
 * version of the tool will not impact the pinmux you originally saw.  These lines can be completely deleted in order to
 * re-solve from scratch.
 */
ECAT1.$suggestSolution      = "ECAT";
ETHERNET1.$suggestSolution  = "ETHERNET";
I2C1.$suggestSolution       = "I2CA";
INPUTXBAR1.$suggestSolution = "INPUTXBAR";
MCAN1.$suggestSolution      = "MCAN";
SCI1.$suggestSolution       = "SCIA";
SCI2.$suggestSolution       = "SCIB";
UART1.$suggestSolution      = "UARTA";
